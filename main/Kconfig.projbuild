## main/Kconfig.projbuild
```kconfig
menu "App Configuration"
    config BROKER_URL
        string "Broker URL"
        default "mqtt://192.169.1.176:1883"
        help
            URL of the broker to connect to
    config GPIO_OUTPUT_0
        int "GPIO output pin 0"
        default 20
        help
            GPIO pin number to be used as GPIO_OUTPUT_IO_0.
    config MQTT_DATA_TOPIC
        string "data topic"
        default "topic/data"
    config MQTT_METRICS_TOPIC
        string "metrics topic"
        default "topic/metrics"
    config WIFI_SSID
        string "WIFI SSID"
        default "SFR_5A5F"
    config WIFI_PASSWORD
        string "WIFI Password"
        default ""
    choice WIFI_SCAN_METHOD
        prompt "WiFi Scan Method"
        default WIFI_SCAN_METHOD_ALL_CHANNEL
        help
            WiFi scan method:
            If "Fast" is selected, scan will end after find SSID match AP.

            If "All Channel" is selected, scan will end after scan all the channel.

        config WIFI_SCAN_METHOD_FAST
            bool "Fast"
        config WIFI_SCAN_METHOD_ALL_CHANNEL
            bool "All Channel"
    endchoice

    menu "WiFi Scan threshold"
    config WIFI_SCAN_RSSI_THRESHOLD
        int "WiFi minimum rssi"
        range -127 0
        default -127
        help
            The minimum rssi to accept in the scan mode.
        choice WIFI_SCAN_AUTH_MODE_THRESHOLD
            prompt "WiFi Scan auth mode threshold"
            default WIFI_AUTH_OPEN
            help
                The weakest authmode to accept in the scan mode.
        config WIFI_AUTH_OPEN
            bool "OPEN"
        config WIFI_AUTH_WEP
                bool "WEP"
            config WIFI_AUTH_WPA_PSK
                bool "WPA PSK"
            config WIFI_AUTH_WPA2_PSK
                bool "WPA2 PSK"
            config WIFI_AUTH_WPA_WPA2_PSK
                bool "WPA WPA2 PSK"
            config WIFI_AUTH_WPA2_ENTERPRISE
                bool "WPA2 ENTERPRISE"
            config WIFI_AUTH_WPA3_PSK
                bool "WPA3 PSK"
            config WIFI_AUTH_WPA2_WPA3_PSK
                bool "WPA2 WPA3 PSK"
            config WIFI_AUTH_WAPI_PSK
                bool "WAPI PSK"
        endchoice
    endmenu
    choice WIFI_CONNECT_AP_SORT_METHOD
        prompt "WiFi Connect AP Sort Method"
        default WIFI_CONNECT_AP_BY_SIGNAL
        help
            WiFi connect AP sort method:
            If "Signal" is selected, Sort matched APs in scan list by RSSI.
            If "Security" is selected, Sort matched APs in scan list by security mode.
        config WIFI_CONNECT_AP_BY_SIGNAL
            bool "Signal"
        config WIFI_CONNECT_AP_BY_SECURITY
            bool "Security"
    endchoice
endmenu
```
